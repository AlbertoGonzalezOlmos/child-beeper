## main/Kconfig.projbuild
```kconfig
config BEEPER_DESIGNER_FONTS
    bool
    default y
    select LV_FONT_MONTSERRAT_14
    select LV_FONT_MONTSERRAT_20
    select LV_FONT_MONTSERRAT_28
    select LV_FONT_MONTSERRAT_32
    select LV_FONT_UNSCII_8
    select LV_FONT_UNSCII_16
```
